## components/esp_isotp/Kconfig
```kconfig
menu "ISO-TP Protocol"

    config ISO_TP_DEFAULT_BLOCK_SIZE
        int "Default Block Size"
        default 0
        range 0 32
        help
            Consecutive frames the receiver accepts before it sends another
            flow control. 0 is ISO 15765-2 BS=0: one flow control, then the
            sender streams the rest of the PDU. The RX queue has to absorb
            that burst. 1..32 send another flow control after that many frames.

    config ISO_TP_DEFAULT_ST_MIN_US
        int "Default STmin (microseconds)"
        default 0
        range 0 50000
        help
            The STmin parameter specifies the minimum time gap allowed between
            the transmission of consecutive frame network protocol data units.
            0 = no delay, 1-50000 microseconds for timing control.

    config ISO_TP_MAX_WFT_NUMBER
        int "Maximum Wait Frame Number"
        default 1
        range 1 10
        help
            This parameter indicates how many FC N_PDU WTs (Wait frames) can be
            transmitted by the receiver in a row before giving up.

    config ISO_TP_DEFAULT_RESPONSE_TIMEOUT_US
        int "Default Response Timeout (microseconds)"
        default 1000000
        range 10000 5000000
        help
            The default timeout to use when waiting for a response during a
            multi-frame send or receive operation (N_Bs: the flow control
            after a first frame; N_Cr: the next consecutive frame).
            ISO 15765-2 names 1000 ms for both; MeatPi default 1000000 since
            2026-10-19 (100000 before: an ECU busy with a flash block that
            answered flow control late aborted the transfer).
            Common values: 100000 (100ms), 1000000 (1s).

    config ISO_TP_FRAME_PADDING
        bool "Enable Frame Padding"
        default n
        help
            Enable padding of ISO-TP message frames to full CAN frame size.
            When enabled, frames are padded with ISO_TP_FRAME_PADDING_VALUE.

    config ISO_TP_FRAME_PADDING_VALUE
        hex "Frame Padding Value"
        default 0xAA
        range 0x00 0xFF
        depends on ISO_TP_FRAME_PADDING
        help
            Value used for padding when ISO_TP_FRAME_PADDING is enabled.
            Common values: 0x00, 0xAA, 0xCC, 0xFF.

endmenu
```
